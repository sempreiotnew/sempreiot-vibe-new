## firmware/components/features/siot_sensing/Kconfig
```kconfig
menu "SempreIoT heat and humidity sensing (siot_sensing)"

    config SIOT_FEATURE_SENSING
        bool "Heat and humidity rules on this unit (protocol section 7.1.6)"
        default n
        help
            Samples the unit's temperature / humidity sensor once per second
            and raises HEAT_ALARM (57.0 C), HEAT_RISE_ALARM (8.0 C in 60 s),
            SENSOR_WET (99.7 %) and SENSOR_FAULT; fills TEMP / HUMIDITY in the
            unit's EVENT and HEARTBEAT. Does nothing on a model whose pin map
            has no sensor bus. Every number:
            docs/phases-development/phase5-heat-humidity-sensing-brief.md
            section 4. Node image; the battery unit's side is not written yet.

    config SIOT_SENSING_DTR_TEST
        bool "Bench: exercise the sensor's interrupt pin on a unit that is awake"
        depends on SIOT_FEATURE_SENSING
        default n
        help
            The DTR test, part A (brief section 10.1): every 60 s the
            temperature threshold of the sensor is re-armed at the current
            reading + 4.0 C (what a battery unit does at each wake), and every
            change of the interrupt pin is logged with the status register.
            Off: the threshold stays at 57 C. Detection on a mains unit never
            depends on the pin either way.

endmenu
```

## firmware/components/net/siot_link/Kconfig
```kconfig
menu "SempreIoT link"

    config SIOT_BENCH_BOARD_DEAF
        bool "BENCH ONLY: this node never reaches the central"
        default n
        help
            RELAXED FOR THE BENCH (docs/ota/before-production.md item 12).
            The node is told a board access point address that does not
            exist, so every connect to the board ends in "no such access
            point": a unit out of the central's reach, on a table where
            every unit hears every other. Such a unit can never be the
            root. Built by `firmware/build.sh node --deaf` into its own
            directory (apps/node/build-deaf); never set it in
            apps/node/sdkconfig.defaults — ci/check.sh --release fails
            while any node configuration has it.

endmenu
```

## firmware/components/platform/siot_sensor/Kconfig
```kconfig
menu "SempreIoT sensors (siot_sensor)"

    config SIOT_SENSOR_MOCK
        bool "Mock backend (no detector hardware)"
        default y
        help
            Scripted smoke / temperature / humidity values and a fixed battery
            percentage, for devkits without the detector PCB
            (docs/phases-development/phase2-leaf-brief.md section 3).
            Off = the real HDC2080 temperature / humidity sensor on the unit's
            I2C bus (docs/phases-development/phase5-heat-humidity-sensing-brief.md);
            the ADPD188BI smoke sensor and the battery ADC are still to come.

    config SIOT_SENSOR_MOCK_BATTERY_PCT
        int "Mock battery percentage reported in HEARTBEAT / EVENT"
        depends on SIOT_SENSOR_MOCK
        default 100
        range 0 100

    config SIOT_SENSOR_MOCK_TEMP_X10
        int "Mock temperature, tenths of a degree C"
        depends on SIOT_SENSOR_MOCK
        default 250

    config SIOT_SENSOR_MOCK_SCENARIO
        int "Mock scenario (0 steady, 1 slow heat to 60 C, 2 fast rise, 3 wet)"
        depends on SIOT_SENSOR_MOCK
        default 0
        range 0 3
        help
            What the mock temperature / humidity does after
            SIOT_SENSOR_MOCK_SCENARIO_START_S, so the heat and humidity rules
            (protocol 7.1.6) can be seen on a devkit:
              0  steady at SIOT_SENSOR_MOCK_TEMP_X10, 45 %
              1  +0.1 C per second (6 C a minute: below the rate-of-rise
                 rule) up to 60 C, held 30 s, then back down: the FIXED
                 alarm at 57 C, alone
              2  +10 C in 40 s, held 30 s, then back down: the RATE-OF-RISE alarm
              3  humidity 100 % for 60 s, then back to 45 %: "sensor molhado"

    config SIOT_SENSOR_MOCK_SCENARIO_START_S
        int "Mock scenario: seconds after boot before it starts"
        depends on SIOT_SENSOR_MOCK
        default 180
        range 0 3600

    config SIOT_SENSOR_SUPPLY_MV
        int "HDC2080 supply voltage, millivolts"
        depends on !SIOT_SENSOR_MOCK
        default 3300
        range 1620 3600
        help
            Used only for the datasheet's supply correction of the
            temperature (0.08 C per volt above 1.8 V). The development unit
            feeds the sensor 3.3 V; THE FINAL PRODUCT IS 1800
            (docs/ota/before-production.md).

endmenu
```
