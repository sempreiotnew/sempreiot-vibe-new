## components/features/siot_leafmgr/Kconfig
```kconfig
menu "SempreIoT leaf manager (siot_leafmgr)"

    config SIOT_FEATURE_LEAFMGR
        bool "Parent role for battery leafs on this node (protocol section 12.11)"
        default n
        help
            Answers a leaf's HEARTBEAT / EVENT with the 9-byte leaf ACK
            (PENDING, NO_PATH, EPOCH, CHANNEL), forwards its frames into the
            mesh, takes custody of its events until the board's ACK, keeps a
            mailbox of downlink frames for it while it sleeps and delivers
            them on its next wake. Node image only.

    config SIOT_LEAFMGR_MAX_LEAVES
        int "Leafs this node keeps state for"
        depends on SIOT_FEATURE_LEAFMGR
        default 16
        range 1 64
        help
            About 1.2 KB each (mailbox of 4 frames). Entries silent for 180 s
            are dropped, so the number bounds concurrent leafs, not lifetime.

endmenu
```

## components/net/siot_leafcore/Kconfig
```kconfig
menu "SempreIoT leaf (siot_leafcore)"

    choice SIOT_LEAF_SLEEP_MODE
        prompt "Sleep between wakes"
        default SIOT_LEAF_SLEEP_DEEP
        help
            DEEP is the product and the bench default: every wake is a reboot,
            state lives in RTC memory (protocol section 12.2). LIGHT and NONE
            keep the same state machine running for a debugger session; they
            never fake a shorter wake.

        config SIOT_LEAF_SLEEP_DEEP
            bool "Deep sleep (timer + button wake)"
        config SIOT_LEAF_SLEEP_LIGHT
            bool "Light sleep (bench: RAM kept, console survives)"
        config SIOT_LEAF_SLEEP_NONE
            bool "No sleep (bench: task delay between cycles)"
    endchoice

    config SIOT_LEAF_HB_INTERVAL_S
        int "Heartbeat interval (s)"
        default 60
        range 5 60
        help
            Protocol section 12.12 fixes 60 s (3 misses = 180 s under the
            200 s NFPA limit). Below 60 is a bench setting only: the board
            still applies its 180 s rule.

    config SIOT_LEAF_SETUP_WINDOW_S
        int "Setup window: seconds without a provisioning request before sleep"
        default 120
        help
            Protocol section 12.9: the window restarts on every HTTP request
            (/info, /identify, /provision...) and when a phone joins; a phone
            that merely stays associated is NOT activity. Then deep sleep with
            the button as the only wake source.

    config SIOT_LEAF_SETUP_MAX_S
        int "Setup: absolute cap from boot, whatever happens (s)"
        default 600
        help
            Battery backstop (never waste battery): even with a phone talking
            to it, an unprovisioned leaf sleeps this long after boot. A short
            press opens a new window.

    config SIOT_LEAF_BENCH_PARENT_MAC
        string "Bench: bind to this parent MAC when no ONLINE node offers"
        default ""
        help
            AA:BB:CC:DD:EE:FF of a node devkit. Empty = discovery only
            (protocol section 12.3: only ONLINE nodes answer, so with the
            board off nothing offers). Lets the first sleep-cycle test run
            without a board; the node's hardware ACK still confirms delivery.

endmenu
```

## firmware/components/core/siot_safr/Kconfig
```kconfig
menu "SempreIoT SAFR (siot_safr)"

    config SIOT_SAFR_DEDUP_CAP
        int "Dedupe table entries (SRC_MAC, MSG_ID)"
        default 16
        range 4 64
        help
            Recent (SRC_MAC, MSG_ID) pairs kept for SIOT_SAFR_DEDUP_TTL_MS so a
            fast retransmission (same MSG_ID, fresh MSG_CTR - spec 9.1) is
            processed once and ACKed every time. 16 was the POC value
            (pocs/node/main/node_mesh.c DEDUP_CAP).

    config SIOT_SAFR_DEDUP_TTL_MS
        int "Dedupe window (ms)"
        default 30000
        help
            Spec 9.1: "within a 30 s window".

    config SIOT_SAFR_PEERS_MAX
        int "Replay table entries (one per SRC_MAC)"
        default 32
        range 4 128
        help
            Last (BOOT_CTR, MSG_CTR) kept per SRC_MAC for the replay check of
            spec 4. The board sees every device on site (blueprint target 50
            units => set higher there); a node sees the board and the central.
            Least-recently-heard entry is evicted when full.

    config SIOT_SAFR_HANDLERS_MAX
        int "Dispatcher slots (one per MSG_TYPE)"
        default 16
        range 4 64
        help
            Phase 1 registers at most 10 (MSG_TYPE 0x01..0x0A); features add
            new types (features/README.md).

endmenu
```

## firmware/components/features/siot_ota_board/Kconfig
```kconfig
menu "SempreIoT firmware update (siot_ota_board, siot_ota_node)"

    config SIOT_FEATURE_OTA
        bool "Firmware update over the link and the mesh (protocol section 13)"
        default y
        help
            Board: takes an image from the tablet, updates itself, hands a
            stored image to the units. Node: takes the board's offer. On by
            default, unlike the other features: every product image must be
            updatable. The options below are the same for the board and the
            node.

    config SIOT_OTA_TEST_ANY_VERSION
        bool "TEST ONLY: accept any version (the same one again, an older one)"
        default y
        help
            *** MUST BE OFF IN PRODUCTION — docs/ota/before-production.md, item 1. ***

            Protocol section 13.2: a unit installs an image only when its
            version is NEWER than the one it runs. That rule is what stops an
            old, vulnerable release from being put back on a unit. It is
            switched off here, on purpose, since 2026-09-29, so the same test
            image can be pushed over and over on the bench.

            firmware/ci/check.sh --release refuses to pass while this is on.

    config SIOT_OTA_ALLOW_FORCE
        bool "Bench: honour FORCE (install an older or the same version)"
        default n
        help
            Protocol section 13.2. A production build leaves this off and
            answers FORCE_REFUSED. Turn it on for a bench board that must be
            taken back to an older image over the link.

    config SIOT_OTA_SELFTEST_FAIL
        bool "Bench: this image fails its self-test (rollback test, check O4)"
        default n
        help
            A board image built with this on never confirms itself: 120 s
            after it boots from an update the board goes back to the image it
            ran before. Never release a build with this on.

    config SIOT_OTA_SELFTEST_S
        int "Seconds a new board image has to pass its self-test"
        default 120
        range 20 600

endmenu
```

## firmware/components/platform/siot_devtab/Kconfig
```kconfig
menu "SempreIoT device table (siot_devtab)"

    config SIOT_DEVTAB_CAP
        int "Maximum devices in the board's table"
        default 120
        range 8 250
        help
            One NVS blob per device (~57 bytes = 3 NVS entries) in the 24 KB
            "nvs" partition shared with Wi-Fi. 120 leaves headroom; 250 needs
            the partition decision recorded in the OTA blueprint §8
            (installation-lifecycle-v1.md §3.1). Never raise it in the field.

endmenu
```

## firmware/components/platform/siot_hal_serial/Kconfig
```kconfig
menu "SempreIoT serial link peripheral (siot_hal_serial)"

    choice SIOT_SERIAL_LINK
        prompt "Peripheral carrying the SAFR byte stream to the tablet"
        default SIOT_SERIAL_LINK_USB_SERIAL_JTAG
        help
            Product board: the S3's native USB on GPIO 19/20 (USB-Serial-JTAG,
            seen as /dev/cu.usbmodem*). Round-1 bench: UART0 on GPIO 43/44
            through the USB-TTL adapter (no USB connector populated) — also
            the console/flash port, so the text console must be off
            (CONFIG_ESP_CONSOLE_NONE) when UART0 carries the link.

        config SIOT_SERIAL_LINK_UART0
            bool "UART0 via the USB-UART bridge (GPIO 43/44)"
        config SIOT_SERIAL_LINK_USB_SERIAL_JTAG
            bool "Native USB-Serial-JTAG (GPIO 19/20)"
    endchoice

endmenu
```

## firmware/components/platform/siot_identity/Kconfig
```kconfig
menu "SempreIoT identity (siot_identity)"

    config SIOT_DEV_MODEL
        string "Device model string"
        default "SIOT-NODE-01"
        help
            Reported in /info and INSTALLATION and used to select the pin map
            (siot_board_def, tools/pinmap/pinmap.yaml). A board image must use
            a model starting with "SIOT-BOARD" so the installer app's wizard
            recognises it (pocs/APP-BRIEF.md section 5).

    config SIOT_FACTORY_PARTITION
        string "NVS partition holding the factory identity"
        default "nvs_factory"
        help
            Written once by tools/make_sticker.py + nvs_partition_gen.py,
            read-only in firmware, survives a full erase of "nvs"
            (OTA blueprint section 1, brief section 4.1).

endmenu
```

## firmware/components/platform/siot_sensor/Kconfig
```kconfig
menu "SempreIoT sensors (siot_sensor)"

    config SIOT_SENSOR_MOCK
        bool "Mock backend (no detector hardware)"
        default y
        help
            Scripted smoke / temperature / humidity values and a fixed battery
            percentage, for devkits without the detector PCB
            (docs/phases-development/phase2-leaf-brief.md section 3). The
            real ADPD188BI / HDC2080 / ADC backend is the sensing phase.

    config SIOT_SENSOR_MOCK_BATTERY_PCT
        int "Mock battery percentage reported in HEARTBEAT / EVENT"
        depends on SIOT_SENSOR_MOCK
        default 100
        range 0 100

    config SIOT_SENSOR_MOCK_TEMP_X10
        int "Mock temperature, tenths of a degree C"
        depends on SIOT_SENSOR_MOCK
        default 250

endmenu
```

## pocs/board/main/Kconfig.projbuild
```kconfig
menu "SIOT Board (tablet serial link)"

    choice SIOT_SERIAL_LINK
        prompt "Peripheral carrying the SAFR byte stream to the tablet"
        default SIOT_SERIAL_LINK_USB_SERIAL_JTAG
        help
            docs/definition-central.md: the product board's tablet link is
            the S3's native USB on GPIO19/20 (USB-Serial-JTAG); UART0 on
            GPIO43/44 is the flash/debug port. Default = native USB. Pick
            UART0 for a bench where the USB connector is not populated and
            the tablet hangs off the USB-TTL adapter on 43/44 (that is what
            pocs/board/sdkconfig.defaults selects for POC round 1).

        config SIOT_SERIAL_LINK_UART0
            bool "UART0 via the devkit's USB-UART bridge chip (GPIO43/44)"
        config SIOT_SERIAL_LINK_USB_SERIAL_JTAG
            bool "Native USB-Serial-JTAG (the connector seen as /dev/cu.usbmodem*)"
    endchoice

endmenu
```

## pocs/components/siot_prov/Kconfig.projbuild
```kconfig
menu "SIOT Provisioning (autoconnect POC)"

    config SIOT_FACTORY_DEV_ID
        string "Factory device id (sticker) -- POC fallback only"
        default "dev-001"
        help
            pocs/POC-BRIEF.md section 4.1 says the factory NVS namespace
            "siot_fact" (id, pop) is written by tools/make_sticker.py and
            must never be generated at runtime. That tool does not exist in
            this repo yet, so this value is used ONLY when "siot_fact" is
            empty in NVS, purely to unblock this POC on a bare devkit.
            Remove once the factory partition flow (make_sticker.py +
            nvs_partition_gen) exists.

    config SIOT_FACTORY_POP
        string "Factory POP secret (sticker) -- POC fallback only"
        default "abc123POP0000"
        help
            See SIOT_FACTORY_DEV_ID. WPA2 requires 8+ characters; the
            blueprint specifies 16+ for the real sticker POP.

    config SIOT_DEV_MODEL
        string "Device model string"
        default "SIOT-SENSOR-01"
        help
            pocs/APP-BRIEF.md section 5 step 2: the board's sticker model
            must start with "SIOT-BOARD" so the app's wizard can detect it
            automatically -- set this to e.g. "SIOT-BOARD-01" when building
            for the board role below.

    choice SIOT_ROLE
        prompt "Unit role"
        default SIOT_ROLE_NODE
        help
            POST /enroll (pocs/POC-BRIEF.md section 5) is only served when
            this is the board.

        config SIOT_ROLE_NODE
            bool "node (AC device / battery detector)"
        config SIOT_ROLE_BOARD
            bool "board (raises the installation network; never a mesh node)"
    endchoice

endmenu
```
